/*********************************************************************
This is a Time Bomb using a Monochrome OLED based on SH1106 drivers.

Written by Xavier Perseguers
BSD license, check license.txt for more information
*********************************************************************/

#include <SPI.h>
#include <Wire.h>
#include <Adafruit_GFX.h>
#include <SH1106.h>

/* Mapping:
 *  
 * GND => GND
 * 5V  => VDD
 *  9  => SDA (D1/MOSI)
 * 10  => SCK (D0/CLK)
 * 11  => DC
 * 12  => RES
 * 13  => CS
 */

// If using software SPI (the default case):
#define OLED_MOSI   9
#define OLED_CLK   10
#define OLED_DC    11
#define OLED_RESET 12
#define OLED_CS    13
Adafruit_SH1106 display(OLED_MOSI, OLED_CLK, OLED_DC, OLED_RESET, OLED_CS);

#define SWITCH      2
#define LED_GREEN   3
#define LED_RED     4

#define WIRE_YELLOW 6
#define WIRE_GREEN  7

/* Uncomment this block to use hardware SPI
#define OLED_DC     6
#define OLED_CS     7
#define OLED_RESET  8
Adafruit_SH1106 display(OLED_DC, OLED_RESET, OLED_CS);
*/

static const unsigned char PROGMEM arrow[] =
{
0x0,0x0,0x0,0x0,0x0,0x0,0x0,0x0,
0x0,0x0,0x0,0x0,0x0,0x0,0x0,0x0,
0x0,0x0,0x0,0x0,0x0,0x0,0x0,0x0,
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0x0,0x0,0x0,0x0,0x0,0x0,0x0,0x0
};

static const unsigned char PROGMEM bang[] =
{
0xff,0xff,0xff,0xff,0xff,0xff,0xff,0xff,0xff,0xff,0xff,0xff,0xff,0xff,0xff,0xff,
0xff,0xff,0xff,0xff,0xff,0xff,0xff,0xff,0xff,0xff,0xff,0xff,0xff,0xff,0xff,0xff,
0xff,0xff,0xff,0xff,0xff,0xff,0xff,0xff,0xff,0xff,0xff,0x3f,0xff,0xff,0xff,0xff,
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0xff,0xff,0xff,0xff,0xff,0xff,0xff,0xff,0xff,0xff,0xff,0xff,0xff,0xff,0xff,0xff
};

#if (SH1106_LCDHEIGHT != 64)
#error("Height incorrect, please fix Adafruit_SH1106.h!");
#endif

int switchState = 0;
int timer = 2000;
int timerStep = 4;  // 4 = normal speed
int bombEnabled = 0;

void setup() {
  pinMode(SWITCH, INPUT);
  pinMode(LED_GREEN, OUTPUT);
  pinMode(LED_RED, OUTPUT);
  pinMode(WIRE_YELLOW, INPUT);
  pinMode(WIRE_GREEN, INPUT);

  // by default, we'll generate the high voltage from the 3.3v line internally! (neat!)
  display.begin(SH1106_SWITCHCAPVCC);
  // init done
  
  // clear the default buffer (Adafruit logo)
  display.clearDisplay();

  // turn on green LED
  digitalWrite(LED_GREEN, HIGH);

  display.setTextSize(2);
  display.setTextColor(WHITE);
  display.setCursor(0, 12);
  display.println("Don't\npress");
  display.drawBitmap(64, 0, arrow, 64, 33, 1);
  
  display.display();
}

void loop() {
  if (bombEnabled) {
    display.clearDisplay();
    if (digitalRead(WIRE_GREEN) == LOW) {
      // green wire is disconnected, great!
      stopBomb();
      digitalWrite(LED_GREEN, HIGH);
      digitalWrite(LED_RED, LOW);
      return;
    }
    if (digitalRead(WIRE_YELLOW) == LOW) {
      // yellow wire is disconnected, bad idea ^^
      timerStep = 20; // accelerate the timer's pace
    }
  
    if (timer > timerStep) {
      timer -= timerStep;
      printTimer();
      delay(10);
    } else {
      display.drawBitmap(0, 0, bang, 128, 64, 1);
      display.display();
      // switch off red LED
      digitalWrite(LED_RED, LOW);
      delay(5000);  // not really needed but why keep refreshing the display?
    }
  } else {
    switchState = digitalRead(SWITCH);
    if (switchState == HIGH) {
      startBomb();
    } else {
      delay(100);
    }
  }
}

void startBomb() {
  // blink green LED
  for (int i=0; i<7; i++) {
    digitalWrite(LED_GREEN, i % 2 == 0 ? LOW : HIGH);
    delay(300);
  }

  // turn on red LED (green is off since odd number of cycles while blinking)
  digitalWrite(LED_RED, HIGH);

  display.clearDisplay();
  display.setTextSize(3); // char: width=17, height=21
  display.setTextColor(WHITE);
  printTimer();
  bombEnabled = 1;

  // still wait a bit (gnark gnark gnark)
  delay(2000);
}

void stopBomb() {
  bombEnabled = 0;
}

void printTimer() {
  int hundredths = timer % 100;
  int seconds = (timer - hundredths) / 100;

  display.setCursor(21, 20);
  if (seconds < 10) display.print("0");
  display.print(seconds);
  display.print(":");
  if (hundredths < 10) display.print("0");
  display.print(hundredths);
  display.display();
}
